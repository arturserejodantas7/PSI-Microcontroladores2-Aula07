## tests/unit_pedestres/testcase.yaml
```yaml
tests:
  semaforos.unit_pedestres:
    tags: semaforos
    timeout: 300
    platform_allow:
      - frdm_kl25z
      - native_sim
      - qemu_cortex_m0
    integration_platforms:
      - native_sim
```
